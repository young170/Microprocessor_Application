.thumb
.thumb_func
.global main

.equ BTN1_MASK, 0x00800
.equ BTN2_MASK, 0x01000
.equ BTN3_MASK, 0x1000000
.equ BTN4_MASK, 0x2000000

.equ LED1_MASK, 0x02000
.equ LED2_MASK, 0x04000
.equ LED3_MASK, 0x08000
.equ LED4_MASK, 0x10000
.equ LED_ALL_MASK, (LED1_MASK+LED2_MASK+LED3_MASK+LED4_MASK)

.equ GPIO_P0_BASE, 0x50000000
.equ GPIO_OUT_REG_OFFSET, 0x504
.equ GPIO_IN_REG_OFFSET, 0x510
.equ GPIO_DIR_REG_OFFSET, 0x514
.equ GPIO_DIRSET_REG_OFFSET, 0x518
.equ GPIO_OUTCLR_REG_OFFSET, 0x50C
.equ GPIO_OUTSET_REG_OFFSET, 0x508

.equ GPIO_PIN_CNF_11_OFFSET, 0x72C
.equ GPIO_PIN_CNF_12_OFFSET, 0x730
.equ GPIO_PIN_CNF_13_OFFSET, 0x760
.equ GPIO_PIN_CNF_14_OFFSET, 0x764

main:
  BL SETTING_GPIO
Loop:
  BL PROB1
  BL PROB2
  B Loop

SETTING_GPIO:
  LDR R0, =GPIO_P0_BASE
  LDR R2, =LED_ALL_MASK
  STR R2, [R0, #GPIO_DIRSET_REG_OFFSET]

  STR R2, [R0, #GPIO_OUTSET_REG_OFFSET]

  LDR R3, =0x0003000c
  STR R3, [R0, #GPIO_PIN_CNF_11_OFFSET]
  STR R3, [R0, #GPIO_PIN_CNF_12_OFFSET]
  STR R3, [R0, #GPIO_PIN_CNF_13_OFFSET]
  STR R3, [R0, #GPIO_PIN_CNF_14_OFFSET]

  LDR R6, =16000000 // timer, 1000ms

  MOV PC, LR

PROB1:
  PUSH {LR}
  BL CHAT_DELAY
  BL TOGGLE_BTN
  POP {LR}
  MOV PC, LR
  
CHAT_DELAY:
  LDR R2, =1600000 // 100ms
CNT_LOOP:
  CMP R2, #0
  ITT NE
  SUBNE R2, R2, #1
  BNE CNT_LOOP
  MOV PC, LR

TOGGLE_BTN:
  LDR R0, =GPIO_P0_BASE
  LDR R1, [R0, #GPIO_IN_REG_OFFSET]
  MVN R1, R1
  
  TST R1, #BTN1_MASK
  BNE LED_TOGGLE

  TST R1, #BTN2_MASK
  BNE LED_TOGGLE

  MOV PC, LR

LED_TOGGLE:
  LDR R0, =GPIO_P0_BASE
  LDR R1, [R0, #GPIO_OUT_REG_OFFSET]
  LDR R3, =LED1_MASK
  LDR R4, =LED2_MASK
  ORR R2, R3, R4

  EOR R1, R1, R2

  STR R1, [R0, #GPIO_OUT_REG_OFFSET]

  MOV PC,LR

PROB2:
  PUSH {LR}
  BL CHAT_DELAY
  BL BLINK_BTN

  CMP R5, #0x1
  IT NE
  BLNE LED_OFF
  ITT NE
  POPNE {LR}
  MOVNE PC, LR

  LDR R0, =8000000
  SUB R6, R6, R0
  CMP R6, #0x0
  IT LT
  BLLT LED_BLINK

  POP {LR}
  MOV PC, LR

BLINK_BTN:
  LDR R0, =GPIO_P0_BASE
  LDR R1, [R0, #GPIO_IN_REG_OFFSET]
  MVN R1, R1
  
  TST R1, #BTN3_MASK
  IT NE
  MOVNE R5, #0x1 // blink

  TST R1, #BTN4_MASK
  IT NE
  MOVNE R5, #0x0 // no blink

  MOV PC, LR

LED_BLINK:
  LDR R6, =16000000 // timer, 1000ms
  LDR R0, =GPIO_P0_BASE
  LDR R1, [R0, #GPIO_OUT_REG_OFFSET]
  LDR R3, =LED3_MASK

  EOR R1, R1, R3

  STR R1, [R0, #GPIO_OUT_REG_OFFSET]

  MOV PC,LR

LED_OFF:
  LDR R0, =GPIO_P0_BASE
  LDR R1, =LED3_MASK
  STR R1, [R0, #GPIO_OUTSET_REG_OFFSET]
  MOV PC, LR
